## configs/edm-g-imx8mp_android_defconfig
```kconfig
CONFIG_DEFAULT_DEVICE_TREE="imx8mp-edm-g_android"
CONFIG_SYS_MMC_ENV_DEV=2
# Android
CONFIG_FASTBOOT=y
CONFIG_CMD_FASTBOOT=y
CONFIG_FASTBOOT_UUU_SUPPORT=y
CONFIG_LZ4=y
CONFIG_SPL_LZ4=y
CONFIG_FLASH_MCUFIRMWARE_SUPPORT=y
CONFIG_APPEND_BOOTARGS=y
CONFIG_SPL_MMC=y
CONFIG_AVB_WARNING_LOGO=y
CONFIG_AVB_WARNING_LOGO_COLS=0x320
CONFIG_AVB_WARNING_LOGO_ROWS=0xc0
CONFIG_VIRTUAL_AB_SUPPORT=y
CONFIG_ANDROID_SUPPORT=y
CONFIG_ANDROID_AB_SUPPORT=y
CONFIG_ANDROID_BOOT_IMAGE=y
CONFIG_CMD_ERASEENV=y
CONFIG_ANDROID_EXT_DTBO=y
```

## configs/edm-imx95_android_defconfig
```kconfig
CONFIG_DEFAULT_DEVICE_TREE="imx95-edm-evm_android"
CONFIG_DEFAULT_FDT_FILE="imx95-edm-evm_android.dtb"
CONFIG_SYS_MMC_ENV_DEV=0
# Android
CONFIG_LZ4=y
CONFIG_SPL_LZ4=y
CONFIG_FLASH_MCUFIRMWARE_SUPPORT=y
CONFIG_APPEND_BOOTARGS=y
CONFIG_VIRTUAL_AB_SUPPORT=y
CONFIG_ANDROID_SUPPORT=y
CONFIG_ANDROID_AB_SUPPORT=y
CONFIG_AVB_WARNING_LOGO=y
CONFIG_AVB_WARNING_LOGO_COLS=0x320
CONFIG_AVB_WARNING_LOGO_ROWS=0xC0
CONFIG_PSCI_BOARD_REBOOT=y
CONFIG_DM_RNG=y
CONFIG_IMX_ELE_RNG=y
CONFIG_ELE_SHARED_BUFFER=0x98000000
CONFIG_ARM64_NEON=y
CONFIG_SPL_CRYPTO=y
CONFIG_FSL_ELE_BLOB=y

CONFIG_ANDROID_EXT_DTBO=y
```
